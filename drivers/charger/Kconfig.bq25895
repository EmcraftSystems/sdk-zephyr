## drivers/charger/Kconfig.bq25895
```kconfig
# Copyright (c) 2025 Emcraft Systems
#
# SPDX-License-Identifier: Apache-2.0

config CHARGER_BQ25895
	bool "BQ25895 Battery Charger"
	default y
	depends on DT_HAS_TI_BQ25895_ENABLED
	select I2C
	help
	  Enable BQ25895 battery charger driver.

module = BQ25895
module-str = bq25895

source "subsys/logging/Kconfig.template.log_config"
```

## drivers/display/Kconfig.ed070ec1
```kconfig
# ED070EC1 display controller configuration options

# Copyright (c) 2024 Emcraft Systems
# SPDX-License-Identifier: Apache-2.0

config ED070EC1
	bool "ED070EC1 compatible display controller driver"
	default y
	depends on \
		DT_HAS_SOLOMON_ED070EC1_ENABLED
	select SPI
	help
	  Enable driver for ED070EC1 compatible controller.
```

## drivers/led/Kconfig.is31fl3208a
```kconfig
# Copyright (c) 2025 Emcraft Systems

config IS31FL3208A
	bool "IS31FL3208A LED driver"
	default y
	depends on DT_HAS_ISSI_IS31FL3208A_ENABLED
	select I2C
	help
	  Enable LED driver for Lumissil Microsystems (a division of ISSI)
	  IS31FL3208A. This chip supports up to 18 PWM controlled LEDs.
```

## drivers/rtc/Kconfig.emul
```kconfig
# Copyright (c) 2022 Bjarki Arge Andreasen
# SPDX-License-Identifier: Apache-2.0

config RTC_EMUL
	bool "Emulated RTC driver"
	default y
	depends on DT_HAS_ZEPHYR_RTC_EMUL_ENABLED
	help
	  Enable emulated Real-Time Clock (RTC) driver.

config RTC_EMUL_SAVE_PERIOD_SEC
	int "RTC emulation periodic save period (seconds)"
	default 60
	help
	  Set the period in seconds for how often the emulated RTC time is saved
	  to persistent storage. A value of 0 disables periodic saving.
```

## drivers/rtc/Kconfig.pcf85263a
```kconfig
# NXP PCF85263A RTC

# Copyright (c) 2024 Emcraft Systems
# SPDX-License-Identifier: Apache-2.0

config RTC_PCF85263A
	bool "NXP PCF85263A RTC driver"
	default y
	depends on DT_HAS_NXP_PCF85263A_ENABLED
	select I2C
	help
	  Enable the NXP PCF85263A RTC driver.

if RTC_PCF85263A

if RTC_ALARM || RTC_UPDATE

config RTC_PCF85263A_THREAD_STACK_SIZE
	int "Stack size for the PCF85263A interrupt thread"
	default 512
	help
	  Size of the stack used for the thread handling interrupts and dispatching callbacks.

config RTC_PCF85263A_THREAD_PRIO
	int "Priority for the PCF85263A interrupt thread"
	default 0
	help
	  Priority level for the thread handling interrupts and dispatching callbacks.

endif # RTC_ALARM || RTC_UPDATE

endif # RTC_PCF85263A
```

## drivers/rtc/Kconfig.rtc_emul
```kconfig
config RTC_EMUL_SAVE_PERIOD_SEC
	int "RTC emulation periodic save period (seconds)"
	default 60
	help
	  Set the period in seconds for how often the emulated RTC time is saved
	  to persistent storage. A value of 0 disables periodic saving.
```

## dts/bindings/charger/ti,bq25895.yaml
```yaml
#
# SPDX-License-Identifier: Apache-2.0

description: BQ25895 driver on I2C bus

compatible: "ti,bq25895"

include: ["i2c-device.yaml", "battery.yaml"]

properties:

  irq-gpios:
    type: phandle-array
    required: true
    description: Open drain IRQ pin (active low)

  ce-gpios:
    type: phandle-array
    description: Charge enable pin (active low)

  inlim:
    type: int
    description: Input current limit (mA)

  vindpm_os:
    type: int
    description: Input voltage limit offset (mV)

  vsysmin:
    type: int
    description: Minimum system voltage (mV)

  batcomp:
    type: int
    description: IR compensation resistor (mOhm)

  vclamp:
    type: int
    description: IR compensation voltage clamp (mV)

  treg:
    type: int
    description: Termal regulation threshold (C)

  boostv:
    type: int
    description: Boost mode voltage regulation (mV)

  vindpm:
    type: int
    description: Absolute VINDPM threshold, disables relative setting (mV)
```

## dts/bindings/led/issi,is31fl3208a.yaml
```yaml
# Copyright (c) 2025 Emcraft Systems

description: |
  is31fl3208a LED driver for Lumissil Microsystems (a division of ISSI)

compatible: "issi,is31fl3208a"

include: ["i2c-device.yaml", "led-controller.yaml"]

properties:
  max-output-current:
    required: true
    type: int
    enum:
      - 0
      - 16
      - 17
      - 18
      - 19
    description: |
      LED current limit index.

child-binding:
  properties:
    label:
      required: true
    index:
      required: true
    color-mapping:
      required: true
```

## dts/bindings/rtc/nxp,pcf85263a.yaml
```yaml
# Copyright (c)  2024 Emcraft Systems
# SPDX-License-Identifier: Apache-2.0

description: NXP PCF85263A RTC

compatible: "nxp,pcf85263a"

include:
  - name: rtc-device.yaml
  - name: i2c-device.yaml
  - name: pm.yaml
    property-allowlist:
      - wakeup-source

properties:

  inta-gpios:
    type: phandle-array
    description: |
      GPIO connected to the PCF85263A INTA interrupt output. This signal is open-drain, active low.

  inta-mode:
    type: int
    default: 0
    description: |
      INTA pin output mode.
```

## dts/bindings/sensor/ti,bq274xx.yaml
```yaml
#
# Copyright (c) 2020 Linumiz
#
# SPDX-License-Identifier: Apache-2.0
#

description: Texas Instruments BQ274xx Fuel Gauge

compatible: "ti,bq274xx"

include: [sensor-device.yaml, i2c-device.yaml]

properties:
  design-voltage:
    type: int
    required: true
    description: Battery Design Voltage in mV (3300 - 4400)

  design-capacity:
    type: int
    required: true
    description: Battery Design Capacity in mAh

  taper-current:
    type: int
    required: true
    description: |
      Current in mA slightly higher than the taper current threshold at which
      point the charger cuts off charging.

  terminate-voltage:
    type: int
    required: true
    description: |
      Minimum operating voltage of your system. This is the target where the
      gauge typically reports 0% capacity. In mV.

  dsg-current-threshold:
    type: int
    description: |
      The value of the Dsg Current Threshold. When zero or absent, the driver
      will not check the register. In mA.

  chg-current-threshold:
    type: int
    description: |
      The value of the Chg Current Threshold. When zero or absent, the driver
      will not check the register. In mA.

  quit-current-threshold:
    type: int
    description: |
      The value of the Quit Current Threshold. When zero or absent, the driver
      will not check the register. In mA.

  chemistry-id:
    type: int
    description: |
      The value of the Chem ID register. When zero, the driver will not check the register.
      See the reference manual for the specific BQ274xx variant for values.

  int-gpios:
    type: phandle-array
    description: |
      The INT signal defaults to active low open drain, so requires a
      pull-up on the board. By default it acts as an output and signals
      specific events happening (e.g. change in State of Charge).
      Note this pin is required for this sensor's power management APIs: in
      shutdown mode it acts as an input and toggling it will make the sensor
      exit the mode.

  zephyr,lazy-load:
    type: boolean
    description: |
      Configuring the sensor can take a long time, using lazy loading we can delay
      until the first sample request and keep the boot time as short as possible.

  report_unfiltered_soc:
    type: boolean
    description: |
      Report StateOfChargeUnfiltered() instead of StateOfCharge().
      This is workaround for the case where fully charged(FC) is not
      detected, so StateOfCharge() is kept at 99% despite charge stopped.
```
